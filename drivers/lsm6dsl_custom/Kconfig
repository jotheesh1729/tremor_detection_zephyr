## drivers/lsm6dsl_custom/Kconfig
```kconfig
config LSM6DSL_CUSTOM
	bool "Custom out-of-tree LSM6DSL accelerometer and gyroscope driver"
	default n
	depends on DT_HAS_ST_LSM6DSL_ENABLED
	select I2C
	select GPIO
	select SENSOR
	help
	  Enable the out-of-tree LSM6DSL driver written for this project,
	  in place of Zephyr's in-tree LSM6DSL driver (CONFIG_LSM6DSL).

if LSM6DSL_CUSTOM

config LSM6DSL_CUSTOM_THREAD_STACK_SIZE
	int "Stack size for the FIFO acquisition thread"
	default 1536
	help
	  Stack size for the dedicated thread that wakes on the watermark
	  interrupt and does the blocking I2C burst read of the FIFO. Sized
	  for the drain buffer (up to 32 samples x 12 bytes, gyro + accel)
	  plus headroom.

config LSM6DSL_CUSTOM_THREAD_PRIORITY
	int "Priority for the FIFO acquisition thread"
	default 2
	help
	  Cooperative priority (lower is higher priority) for the FIFO
	  acquisition thread. Kept high so FIFO drains promptly and does
	  not lose samples to overrun.

endif # LSM6DSL_CUSTOM
```
