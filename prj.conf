## CMakeLists.txt
```
cmake_minimum_required(VERSION 3.28.0)
list(APPEND ZEPHYR_EXTRA_MODULES ${CMAKE_CURRENT_SOURCE_DIR}/drivers/lsm6dsl_custom)
find_package(Zephyr REQUIRED HINTS $ENV{ZEPHYR_BASE})
project(tremor_detection)
target_sources(app PRIVATE
	src/main.c
	src/episode_fsm.c
	src/ble_service.c
	src/dsp/pipeline.c
)
target_include_directories(app PRIVATE src)
```

## Kconfig
```
mainmenu "Tremor and Dyskinesia Detection"

source "Kconfig.zephyr"

menu "Tremor detection DSP pipeline"

config TREMOR_WINDOW_SIZE
	int "DSP window size (samples)"
	default 256
	help
	  Number of accelerometer samples per analysis window. At the
	  configured sample rate, this sets the FFT length and therefore the
	  frequency bin width (sample rate / window size).

config TREMOR_SAMPLE_RATE_HZ
	int "Accelerometer sample rate (Hz)"
	default 104
	help
	  Must match the LSM6DSL ODR configured in the driver
	  (LSM6DSL_ODR_104HZ in drivers/lsm6dsl_custom). Used to convert FFT
	  bin index to frequency in Hz.

config TREMOR_BAND_LOW_HZ
	int "Tremor band lower edge (Hz)"
	default 3
	help
	  Default matches the original class assignment (3-5 Hz). Clinical
	  literature describes a broader range, roughly 3-9 Hz centered
	  around 4-6 Hz; kept configurable rather than hardcoded so this can
	  be revisited once there is real motion data to test against.

config TREMOR_BAND_HIGH_HZ
	int "Tremor band upper edge (Hz)"
	default 5

config DYSKINESIA_BAND_LOW_HZ
	int "Dyskinesia band lower edge (Hz)"
	default 5

config DYSKINESIA_BAND_HIGH_HZ
	int "Dyskinesia band upper edge (Hz)"
	default 7

config TREMOR_EPISODE_WINDOW_COUNT
	int "Episode hysteresis: window count (N)"
	default 5
	help
	  Episode entry uses K-of-N: this many most recent windows are
	  considered when deciding whether to enter an episode.

config TREMOR_EPISODE_ENTER_COUNT
	int "Episode hysteresis: positive windows required (K)"
	default 3
	help
	  Number of positive (tremor or dyskinesia) windows required, out of
	  the last TREMOR_EPISODE_WINDOW_COUNT windows, to enter an episode.

config TREMOR_EPISODE_COOLDOWN_WINDOWS
	int "Episode hysteresis: cooldown length (windows)"
	default 3
	help
	  Number of consecutive negative windows required to exit an
	  episode.

config TREMOR_REPORT_INTERVAL_MIN
	int "BLE summary report interval (minutes)"
	default 5
	help
	  How often to send an aggregated BLE report (episode counts,
	  durations, mean severity) instead of notifying every window.
	  5 min for testing; a real deployment would use something like 360
	  (6h), same code either way.

endmenu
```

## prj.conf
```kconfig
CONFIG_LOG=y
CONFIG_GPIO=y

# Float formatting support for printk's %f specifiers, used throughout
# main.c for logging and live telemetry output.
CONFIG_CBPRINTF_COMPLETE=y
CONFIG_CBPRINTF_FP_SUPPORT=y

# Zephyr's in-tree LSM6DSL driver defaults to enabled whenever a matching
# devicetree node exists (drivers/sensor/st/lsm6dsl/Kconfig, default y).
# It must be turned off so our out-of-tree driver is the only one that
# claims this devicetree instance.
CONFIG_LSM6DSL=n
CONFIG_LSM6DSL_CUSTOM=y

# CMSIS-DSP: real FFT (arm_rfft_fast_f32) for the DSP pipeline window
# analysis, plus the basic math functions the transform code needs.
CONFIG_CMSIS_DSP=y
CONFIG_CMSIS_DSP_TRANSFORM=y
CONFIG_CMSIS_DSP_BASICMATH=y

# cosf/sqrtf/logf/ceilf/floorf (Hann window, FFT, feature extraction).
CONFIG_REQUIRES_FULL_LIBC=y

# FPU: the pipeline runs entirely in single-precision float, and the
# STM32L475's Cortex-M4F has a hardware FPU to run it on.
CONFIG_FPU=y

# BLE: CONFIG_BT_SPI_BLUENRG (the SPBTLE-RF's driver) auto-selects itself
# from the board's own devicetree (hci_spi node, "st,hci-spi-v1") once
# CONFIG_BT is on -- no separate driver Kconfig needed.
CONFIG_BT=y
CONFIG_BT_PERIPHERAL=y
CONFIG_BT_DEVICE_NAME="Tremor Monitor"

# BLE report interval defaults to 5 minutes (see Kconfig). Override here
# for a different interval, e.g. CONFIG_TREMOR_REPORT_INTERVAL_MIN=360 for
# a 6 hour production interval, or a smaller value for testing.
```

## src/main.c
```c
#include <zephyr/kernel.h>
#include <zephyr/device.h>
#include <zephyr/drivers/gpio.h>
#include <zephyr/drivers/sensor.h>
#include <zephyr/logging/log.h>

#include <stdint.h>
#include <string.h>

#include "ble_service.h"
#include "dsp/pipeline.h"
#include "episode_fsm.h"

LOG_MODULE_REGISTER(main, LOG_LEVEL_INF);

/* accel0 alias points at the board's IMU node (boards/st/disco_l475_iot1.dts).
 * Getting the device through this alias, not a node label, is what makes
 * porting to a board with a different IMU a devicetree change instead of
 * an application code change.
 */
static const struct device *const accel = DEVICE_DT_GET(DT_ALIAS(accel0));

/* Local visual feedback, independent of BLE: led0 lit for the duration of
 * any window classified as tremor, led1 for dyskinesia. Both aliases are
 * on-board LEDs already defined by the board's own devicetree.
 */
static const struct gpio_dt_spec led_tremor = GPIO_DT_SPEC_GET(DT_ALIAS(led0), gpios);
static const struct gpio_dt_spec led_dyskinesia = GPIO_DT_SPEC_GET(DT_ALIAS(led1), gpios);

struct accel_sample {
	float ax;
	float ay;
	float az;
	float gx;
	float gy;
	float gz;
};

/* Ring buffer between the driver's FIFO-watermark trigger callback and the
 * DSP thread. Sized well above one FIFO drain batch (16 samples) to absorb
 * scheduling jitter. Overrun policy: drop the newest sample and log it --
 * this preserves the in-progress window's temporal continuity rather than
 * corrupting it by silently overwriting older, not-yet-consumed samples.
 */
K_MSGQ_DEFINE(sample_queue, sizeof(struct accel_sample), 32, 4);

static void accel_trigger_handler(const struct device *dev, const struct sensor_trigger *trig)
{
	struct sensor_value accel_xyz[3];
	struct sensor_value gyro_xyz[3];
	struct accel_sample sample;

	if (sensor_channel_get(dev, SENSOR_CHAN_ACCEL_XYZ, accel_xyz) < 0) {
		return;
	}
	if (sensor_channel_get(dev, SENSOR_CHAN_GYRO_XYZ, gyro_xyz) < 0) {
		return;
	}

	sample.ax = sensor_value_to_float(&accel_xyz[0]);
	sample.ay = sensor_value_to_float(&accel_xyz[1]);
	sample.az = sensor_value_to_float(&accel_xyz[2]);
	sample.gx = sensor_value_to_float(&gyro_xyz[0]);
	sample.gy = sensor_value_to_float(&gyro_xyz[1]);
	sample.gz = sensor_value_to_float(&gyro_xyz[2]);

	if (k_msgq_put(&sample_queue, &sample, K_NO_WAIT) != 0) {
		LOG_WRN("sample queue full, dropping sample");
	}
}

static const char *classification_str(enum tremor_classification c)
{
	switch (c) {
	case TREMOR_CLASS_TREMOR:
		return "tremor";
	case TREMOR_CLASS_DYSKINESIA:
		return "dyskinesia";
	case TREMOR_CLASS_ACTIVITY:
		return "activity";
	default:
		return "none";
	}
}

/* Stats accumulated between BLE reports: periodic radio traffic instead
 * of one notify per window (~1.2s cadence) keeps power draw sane for a
 * battery-powered wearable.
 */
static struct tremor_report pending_report;
static uint32_t report_severity_sum_pct;
static int64_t next_report_at_ms;

static void report_episode(const struct episode_record *record)
{
	uint16_t duration_s = (uint16_t)(record->duration_ms / 1000);
	uint8_t severity_pct = (uint8_t)(record->mean_severity * 100.0f);

	if (record->type == EPISODE_TYPE_TREMOR) {
		pending_report.tremor_episodes++;
		pending_report.tremor_duration_s += duration_s;
	} else {
		pending_report.dyskinesia_episodes++;
		pending_report.dyskinesia_duration_s += duration_s;
	}
	report_severity_sum_pct += severity_pct;
}

static void send_report_if_due(void)
{
	int64_t now = k_uptime_get();
	uint8_t total_episodes;

	if (now < next_report_at_ms) {
		return;
	}
	next_report_at_ms = now + (int64_t)CONFIG_TREMOR_REPORT_INTERVAL_MIN * 60 * 1000;

	total_episodes = pending_report.tremor_episodes + pending_report.dyskinesia_episodes;
	pending_report.mean_severity_pct =
		total_episodes > 0 ? (uint8_t)(report_severity_sum_pct / total_episodes) : 0;

	ble_service_notify_report(&pending_report);

	memset(&pending_report, 0, sizeof(pending_report));
	report_severity_sum_pct = 0;
}

static void dsp_thread(void *p1, void *p2, void *p3)
{
	ARG_UNUSED(p1);
	ARG_UNUSED(p2);
	ARG_UNUSED(p3);

	tremor_pipeline_init();
	episode_fsm_init();
	next_report_at_ms = k_uptime_get() + (int64_t)CONFIG_TREMOR_REPORT_INTERVAL_MIN * 60 * 1000;

	while (1) {
		struct accel_sample sample;
		struct tremor_window_result result;
		struct episode_record record;

		k_msgq_get(&sample_queue, &sample, K_FOREVER);

		if (!tremor_pipeline_add_sample(sample.ax, sample.ay, sample.az, sample.gx,
						 sample.gy, sample.gz, &result)) {
			continue;
		}

		LOG_INF("window: %s peak=%.2fHz rel_pwr=%.2f tremor_pwr=%.3f dysk_pwr=%.3f "
			"entropy=%.2f gyro_rms=%.2f severity=%.2f",
			classification_str(result.classification), (double)result.peak_freq_hz,
			(double)result.relative_power, (double)result.tremor_band_power,
			(double)result.dyskinesia_band_power, (double)result.spectral_entropy,
			(double)result.gyro_rms, (double)result.severity);

		/* ">name:value" lines are picked up by a live serial plotter
		 * during development (Teleplot); classification is 0=none
		 * 1=tremor 2=dyskinesia 3=activity.
		 */
		printk(">peak_freq_hz:%.3f\n", (double)result.peak_freq_hz);
		printk(">relative_power:%.3f\n", (double)result.relative_power);
		printk(">tremor_power:%.4f\n", (double)result.tremor_band_power);
		printk(">dyskinesia_power:%.4f\n", (double)result.dyskinesia_band_power);
		printk(">entropy:%.3f\n", (double)result.spectral_entropy);
		printk(">gyro_rms:%.3f\n", (double)result.gyro_rms);
		printk(">severity:%.3f\n", (double)result.severity);
		printk(">classification:%d\n", (int)result.classification);

		gpio_pin_set_dt(&led_tremor, result.classification == TREMOR_CLASS_TREMOR);
		gpio_pin_set_dt(&led_dyskinesia, result.classification == TREMOR_CLASS_DYSKINESIA);

		if (episode_fsm_update(&result, &record)) {
			LOG_INF("episode closed: type=%s duration=%lldms freq=%.2fHz "
				"mean_severity=%.2f",
				record.type == EPISODE_TYPE_TREMOR ? "tremor" : "dyskinesia",
				record.duration_ms, (double)record.dominant_freq_hz,
				(double)record.mean_severity);
			ble_service_notify_episode(&record);
			report_episode(&record);
		}

		send_report_if_due();
	}
}

K_THREAD_DEFINE(dsp_tid, 2048, dsp_thread, NULL, NULL, NULL, 5, 0, 0);

int main(void)
{
	LOG_INF("booted");

	if (!device_is_ready(accel)) {
		LOG_ERR("accel device not ready");
		return 0;
	}

	if (!device_is_ready(led_tremor.port) || !device_is_ready(led_dyskinesia.port)) {
		LOG_ERR("LED GPIO not ready");
		return 0;
	}
	gpio_pin_configure_dt(&led_tremor, GPIO_OUTPUT_INACTIVE);
	gpio_pin_configure_dt(&led_dyskinesia, GPIO_OUTPUT_INACTIVE);

	static const struct sensor_trigger trig = {
		.type = SENSOR_TRIG_FIFO_WATERMARK,
		.chan = SENSOR_CHAN_ACCEL_XYZ,
	};

	if (sensor_trigger_set(accel, &trig, accel_trigger_handler) < 0) {
		LOG_ERR("failed to set FIFO watermark trigger");
		return 0;
	}

	ble_service_start();

	return 0;
}
```

## src/ble_service.c
```c
#include <zephyr/bluetooth/bluetooth.h>
#include <zephyr/bluetooth/conn.h>
#include <zephyr/bluetooth/gatt.h>
#include <zephyr/bluetooth/hci.h>
#include <zephyr/bluetooth/uuid.h>
#include <zephyr/logging/log.h>
#include <zephyr/sys/byteorder.h>

#include "ble_service.h"

LOG_MODULE_REGISTER(ble_service, LOG_LEVEL_INF);

/* Custom 128-bit UUIDs, arbitrary (private use, no SIG registration needed
 * for a project like this -- same approach every custom GATT service uses,
 * e.g. Nordic's UART service).
 */
static const struct bt_uuid_128 tremor_svc_uuid =
	BT_UUID_INIT_128(BT_UUID_128_ENCODE(0xc9a00000, 0x1fdd, 0x4a7e, 0x9ab0, 0xb1a9c0ab0001));
static const struct bt_uuid_128 report_chrc_uuid =
	BT_UUID_INIT_128(BT_UUID_128_ENCODE(0xc9a00001, 0x1fdd, 0x4a7e, 0x9ab0, 0xb1a9c0ab0001));
static const struct bt_uuid_128 episode_chrc_uuid =
	BT_UUID_INIT_128(BT_UUID_128_ENCODE(0xc9a00002, 0x1fdd, 0x4a7e, 0x9ab0, 0xb1a9c0ab0001));

static void ccc_cfg_changed(const struct bt_gatt_attr *attr, uint16_t value)
{
	ARG_UNUSED(attr);
	ARG_UNUSED(value);
}

BT_GATT_SERVICE_DEFINE(tremor_svc, BT_GATT_PRIMARY_SERVICE(&tremor_svc_uuid),
			BT_GATT_CHARACTERISTIC(&report_chrc_uuid.uuid, BT_GATT_CHRC_NOTIFY,
						BT_GATT_PERM_NONE, NULL, NULL, NULL),
			BT_GATT_CCC(ccc_cfg_changed, BT_GATT_PERM_READ | BT_GATT_PERM_WRITE),
			BT_GATT_CHARACTERISTIC(&episode_chrc_uuid.uuid, BT_GATT_CHRC_NOTIFY,
						BT_GATT_PERM_NONE, NULL, NULL, NULL),
			BT_GATT_CCC(ccc_cfg_changed, BT_GATT_PERM_READ | BT_GATT_PERM_WRITE));

#define REPORT_ATTR_IDX  1
#define EPISODE_ATTR_IDX 4

static const struct bt_data ad[] = {
	BT_DATA_BYTES(BT_DATA_FLAGS, BT_LE_AD_GENERAL | BT_LE_AD_NO_BREDR),
	BT_DATA_BYTES(BT_DATA_UUID128_ALL, BT_UUID_128_ENCODE(0xc9a00000, 0x1fdd, 0x4a7e, 0x9ab0,
							       0xb1a9c0ab0001)),
};
static const struct bt_data sd[] = {
	BT_DATA(BT_DATA_NAME_COMPLETE, CONFIG_BT_DEVICE_NAME, sizeof(CONFIG_BT_DEVICE_NAME) - 1),
};

static void connected(struct bt_conn *conn, uint8_t err)
{
	if (err) {
		LOG_ERR("connection failed: 0x%02x", err);
	} else {
		LOG_INF("connected");
	}
}

static void disconnected(struct bt_conn *conn, uint8_t reason)
{
	LOG_INF("disconnected: 0x%02x", reason);
}

BT_CONN_CB_DEFINE(conn_callbacks) = {
	.connected = connected,
	.disconnected = disconnected,
};

void ble_service_start(void)
{
	int err = bt_enable(NULL);

	if (err) {
		LOG_ERR("bt_enable failed: %d", err);
		return;
	}

	err = bt_le_adv_start(BT_LE_ADV_CONN_FAST_1, ad, ARRAY_SIZE(ad), sd, ARRAY_SIZE(sd));
	if (err) {
		LOG_ERR("advertising failed to start: %d", err);
		return;
	}

	LOG_INF("advertising started");
}

/* Wire format, 7 bytes, little-endian:
 *   [0] tremor episode count      [1] dyskinesia episode count
 *   [2:3] tremor duration (s)     [4:5] dyskinesia duration (s)
 *   [6] mean severity (0-100)
 */
void ble_service_notify_report(const struct tremor_report *report)
{
	uint8_t buf[7];

	buf[0] = report->tremor_episodes;
	buf[1] = report->dyskinesia_episodes;
	sys_put_le16(report->tremor_duration_s, &buf[2]);
	sys_put_le16(report->dyskinesia_duration_s, &buf[4]);
	buf[6] = report->mean_severity_pct;

	bt_gatt_notify(NULL, &tremor_svc.attrs[REPORT_ATTR_IDX], buf, sizeof(buf));
}

/* Wire format, 6 bytes, little-endian:
 *   [0] type (1=tremor, 2=dyskinesia)   [1:2] duration (s)
 *   [3:4] dominant frequency (deci-Hz)  [5] mean severity (0-100)
 */
void ble_service_notify_episode(const struct episode_record *record)
{
	uint8_t buf[6];

	buf[0] = (uint8_t)record->type;
	sys_put_le16((uint16_t)(record->duration_ms / 1000), &buf[1]);
	sys_put_le16((uint16_t)(record->dominant_freq_hz * 10.0f), &buf[3]);
	buf[5] = (uint8_t)(record->mean_severity * 100.0f);

	bt_gatt_notify(NULL, &tremor_svc.attrs[EPISODE_ATTR_IDX], buf, sizeof(buf));
}
```

## src/ble_service.h
```c
#ifndef TREMOR_BLE_SERVICE_H_
#define TREMOR_BLE_SERVICE_H_

#include "episode_fsm.h"

/* Aggregated stats since the last report, not a live per-window snapshot --
 * radio traffic for a battery wearable should be periodic, not continuous.
 */
struct tremor_report {
	uint8_t tremor_episodes;
	uint8_t dyskinesia_episodes;
	uint16_t tremor_duration_s;
	uint16_t dyskinesia_duration_s;
	uint8_t mean_severity_pct; /* mean over episodes in this period, 0-100 */
};

/* Starts advertising and registers the GATT service. Call once from main(). */
void ble_service_start(void);

/* Notifies the report characteristic. No-op if nothing is subscribed. */
void ble_service_notify_report(const struct tremor_report *report);

/* Notifies the episode characteristic with a closed episode record.
 * No-op if nothing is subscribed.
 */
void ble_service_notify_episode(const struct episode_record *record);

#endif /* TREMOR_BLE_SERVICE_H_ */
```

## src/episode_fsm.c
```c
#include <string.h>

#include <zephyr/kernel.h>

#include "episode_fsm.h"

#define HISTORY_SIZE   CONFIG_TREMOR_EPISODE_WINDOW_COUNT
#define ENTER_COUNT    CONFIG_TREMOR_EPISODE_ENTER_COUNT
#define COOLDOWN_COUNT CONFIG_TREMOR_EPISODE_COOLDOWN_WINDOWS

enum fsm_state {
	FSM_IDLE,
	FSM_EPISODE,
};

static enum fsm_state state;

/* K-of-N entry history: ring buffer of whether each of the last N windows
 * was "positive" (tremor or dyskinesia), used only while idle.
 */
static bool history[HISTORY_SIZE];
static int history_head;
static int history_positive_count;

/* Running accumulators for the episode currently in progress. */
static int64_t episode_start_ms;
static float episode_freq_sum;
static float episode_severity_sum;
static int episode_window_count;
static int episode_tremor_windows;
static int episode_dyskinesia_windows;
static int consecutive_negative;

static bool is_positive(enum tremor_classification c)
{
	return c == TREMOR_CLASS_TREMOR || c == TREMOR_CLASS_DYSKINESIA;
}

void episode_fsm_init(void)
{
	state = FSM_IDLE;
	memset(history, 0, sizeof(history));
	history_head = 0;
	history_positive_count = 0;
	episode_window_count = 0;
	consecutive_negative = 0;
}

static void history_push(bool positive)
{
	if (history[history_head]) {
		history_positive_count--;
	}
	history[history_head] = positive;
	if (positive) {
		history_positive_count++;
	}
	history_head = (history_head + 1) % HISTORY_SIZE;
}

static void episode_start(void)
{
	state = FSM_EPISODE;
	episode_start_ms = k_uptime_get();
	episode_freq_sum = 0.0f;
	episode_severity_sum = 0.0f;
	episode_window_count = 0;
	episode_tremor_windows = 0;
	episode_dyskinesia_windows = 0;
	consecutive_negative = 0;
}

static void episode_accumulate(const struct tremor_window_result *result)
{
	episode_freq_sum += result->peak_freq_hz;
	episode_severity_sum += result->severity;
	episode_window_count++;

	if (result->classification == TREMOR_CLASS_TREMOR) {
		episode_tremor_windows++;
	} else if (result->classification == TREMOR_CLASS_DYSKINESIA) {
		episode_dyskinesia_windows++;
	}
}

static void episode_close(struct episode_record *out_record)
{
	out_record->type = episode_tremor_windows >= episode_dyskinesia_windows
				    ? EPISODE_TYPE_TREMOR
				    : EPISODE_TYPE_DYSKINESIA;
	out_record->start_time_ms = episode_start_ms;
	out_record->duration_ms = k_uptime_get() - episode_start_ms;
	out_record->dominant_freq_hz =
		episode_window_count > 0 ? episode_freq_sum / episode_window_count : 0.0f;
	out_record->mean_severity =
		episode_window_count > 0 ? episode_severity_sum / episode_window_count : 0.0f;

	state = FSM_IDLE;
	memset(history, 0, sizeof(history));
	history_head = 0;
	history_positive_count = 0;
}

bool episode_fsm_update(const struct tremor_window_result *result,
			 struct episode_record *out_record)
{
	bool positive = is_positive(result->classification);

	if (state == FSM_IDLE) {
		history_push(positive);
		if (history_positive_count >= ENTER_COUNT) {
			episode_start();
			episode_accumulate(result);
		}
		return false;
	}

	/* FSM_EPISODE */
	episode_accumulate(result);

	if (positive) {
		consecutive_negative = 0;
	} else {
		consecutive_negative++;
		if (consecutive_negative >= COOLDOWN_COUNT) {
			episode_close(out_record);
			return true;
		}
	}

	return false;
}
```

## src/episode_fsm.h
```c
#ifndef TREMOR_EPISODE_FSM_H_
#define TREMOR_EPISODE_FSM_H_

#include <stdbool.h>
#include <stdint.h>

#include "dsp/pipeline.h"

enum episode_type {
	EPISODE_TYPE_NONE = 0,
	EPISODE_TYPE_TREMOR,
	EPISODE_TYPE_DYSKINESIA,
};

struct episode_record {
	enum episode_type type;
	int64_t start_time_ms;
	int64_t duration_ms;
	float dominant_freq_hz; /* mean peak frequency across the episode's windows */
	float mean_severity;
};

void episode_fsm_init(void);

/*
 * Feeds one window's classification result into the hysteresis state
 * machine (idle -> candidate (K of N) -> episode -> cooldown -> idle).
 * Returns true and fills *out_record when this call closes out an episode
 * (the cooldown just completed); returns false otherwise.
 */
bool episode_fsm_update(const struct tremor_window_result *result,
			 struct episode_record *out_record);

#endif /* TREMOR_EPISODE_FSM_H_ */
```
